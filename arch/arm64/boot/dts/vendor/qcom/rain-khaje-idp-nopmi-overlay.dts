/dts-v1/;
/plugin/;

#include <dt-bindings/interrupt-controller/arm-gic.h>
#include "rain.dtsi"

/ {
	model = "Qualcomm Technologies, Inc. RAIN KHAJE IDP nopmi";
        compatible = "qcom,khaje-idp", "qcom,khaje", "qcom,idp";
        qcom,msm-id = <0x206 0x10000>;
        qcom,board-id = <0x60022 0x00>;
        qcom,pmic-id = <0x2d 0x00 0x00 0x00>;
};
